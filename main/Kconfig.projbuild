## main/Kconfig.projbuild
```kconfig
menu "Example Configuration"
    choice EXAMPLE_LCD_BUFFER_MODE
        prompt "RGB LCD Buffer Mode"
        default EXAMPLE_USE_SINGLE_FB
        help
            Select the LCD buffer mode.

        config EXAMPLE_USE_SINGLE_FB
            bool "Use single frame buffer"
            help
                Allocate one frame buffer in the driver.
                Allocate one draw buffer in LVGL.

        config EXAMPLE_USE_DOUBLE_FB
            bool "Use double frame buffer"
            help
                Allocate two frame buffers in the driver.
                The frame buffers also work as ping-pong draw buffers in LVGL.

        config EXAMPLE_USE_BOUNCE_BUFFER
            bool "Use bounce buffer"
            help
                Allocate one frame buffer in the driver.
                Allocate two bounce buffers in the driver.
                Allocate one draw buffer in LVGL.
    endchoice

    choice EXAMPLE_LCD_DATA_LINES
        prompt "RGB LCD Data Lines"
        default EXAMPLE_LCD_DATA_LINES_16
        help
            Select the number of data lines of the RGB LCD.

        config EXAMPLE_LCD_DATA_LINES_16
            bool "16 data lines"

        config EXAMPLE_LCD_DATA_LINES_24
            bool "24 data lines"
    endchoice

    config EXAMPLE_LCD_DATA_LINES
        int
        default 16 if EXAMPLE_LCD_DATA_LINES_16
        default 24 if EXAMPLE_LCD_DATA_LINES_24

    menu "GPIO assignment"
        config EXAMPLE_LCD_VSYNC_GPIO
            int "VSYNC GPIO"
            default 41
            help
                GPIO pin number for VSYNC signal.
        config EXAMPLE_LCD_HSYNC_GPIO
            int "HSYNC GPIO"
            default 39
            help
                GPIO pin number for HSYNC signal.
        config EXAMPLE_LCD_DE_GPIO
            int "DE GPIO"
            default 40
            help
                GPIO pin number for DE signal.
        config EXAMPLE_LCD_PCLK_GPIO
            int "PCLK GPIO"
            default 42
            help
                GPIO pin number for PCLK signal.
        config EXAMPLE_LCD_DATA0_GPIO
            int "DATA0 GPIO"
            default 8
            help
                GPIO pin number for data bus[0].
        config EXAMPLE_LCD_DATA1_GPIO
            int "DATA1 GPIO"
            default 3
            help
                GPIO pin number for data bus[1].
        config EXAMPLE_LCD_DATA2_GPIO
            int "DATA2 GPIO"
            default 46
            help
                GPIO pin number for data bus[2].
        config EXAMPLE_LCD_DATA3_GPIO
            int "DATA3 GPIO"
            default 9
            help
                GPIO pin number for data bus[3].
        config EXAMPLE_LCD_DATA4_GPIO
            int "DATA4 GPIO"
            default 1
            help
                GPIO pin number for data bus[4].
        config EXAMPLE_LCD_DATA5_GPIO
            int "DATA5 GPIO"
            default 5
            help
                GPIO pin number for data bus[5].
        config EXAMPLE_LCD_DATA6_GPIO
            int "DATA6 GPIO"
            default 6
            help
                GPIO pin number for data bus[6].
        config EXAMPLE_LCD_DATA7_GPIO
            int "DATA7 GPIO"
            default 7
            help
                GPIO pin number for data bus[7].
        config EXAMPLE_LCD_DATA8_GPIO
            int "DATA8 GPIO"
            default 15
            help
                GPIO pin number for data bus[8].
        config EXAMPLE_LCD_DATA9_GPIO
            int "DATA9 GPIO"
            default 16
            help
                GPIO pin number for data bus[9].
        config EXAMPLE_LCD_DATA10_GPIO
            int "DATA10 GPIO"
            default 4
            help
                GPIO pin number for data bus[10].
        config EXAMPLE_LCD_DATA11_GPIO
            int "DATA11 GPIO"
            default 45
            help
                GPIO pin number for data bus[11].
        config EXAMPLE_LCD_DATA12_GPIO
            int "DATA12 GPIO"
            default 48
            help
                GPIO pin number for data bus[12].
        config EXAMPLE_LCD_DATA13_GPIO
            int "DATA13 GPIO"
            default 47
            help
                GPIO pin number for data bus[13].
        config EXAMPLE_LCD_DATA14_GPIO
            int "DATA14 GPIO"
            default 21
            help
                GPIO pin number for data bus[14].
        config EXAMPLE_LCD_DATA15_GPIO
            int "DATA15 GPIO"
            default 14
            help
                GPIO pin number for data bus[15].
        config EXAMPLE_LCD_DATA16_GPIO
            int "DATA16 GPIO"
            depends on EXAMPLE_LCD_DATA_LINES > 16
            help
                GPIO pin number for data bus[16].
        config EXAMPLE_LCD_DATA17_GPIO
            int "DATA17 GPIO"
            depends on EXAMPLE_LCD_DATA_LINES > 16
            help
                GPIO pin number for data bus[17].
        config EXAMPLE_LCD_DATA18_GPIO
            int "DATA18 GPIO"
            depends on EXAMPLE_LCD_DATA_LINES > 16
            help
                GPIO pin number for data bus[18].
        config EXAMPLE_LCD_DATA19_GPIO
            int "DATA19 GPIO"
            depends on EXAMPLE_LCD_DATA_LINES > 16
            help
                GPIO pin number for data bus[19].
        config EXAMPLE_LCD_DATA20_GPIO
            int "DATA20 GPIO"
            depends on EXAMPLE_LCD_DATA_LINES > 16
            help
                GPIO pin number for data bus[20].
        config EXAMPLE_LCD_DATA21_GPIO
            int "DATA21 GPIO"
            depends on EXAMPLE_LCD_DATA_LINES > 16
            help
                GPIO pin number for data bus[21].
        config EXAMPLE_LCD_DATA22_GPIO
            int "DATA22 GPIO"
            depends on EXAMPLE_LCD_DATA_LINES > 16
            help
                GPIO pin number for data bus[22].
        config EXAMPLE_LCD_DATA23_GPIO
            int "DATA23 GPIO"
            depends on EXAMPLE_LCD_DATA_LINES > 16
            help
                GPIO pin number for data bus[23].
    endmenu
endmenu

menu "WiFi Configuration"
    config WIFI_SSID
        string "WiFi SSID"
        default "your_wifi_network"
        help
            SSID (network name) for the example to connect to.

    config WIFI_PASSWORD
        string "WiFi Password"
        default "your_wifi_password"
        help
            WiFi password (WPA or WPA2) for the example to use.

    config WIFI_MAXIMUM_RETRY
        int "Maximum retry"
        default 5
        help
            Set the maximum connection retry to avoid station reconnecting to the AP unlimited when the AP is really inexistent.

    config WIFI_CONNECT_TIMEOUT
        int "Connection timeout (ms)"
        default 30000
        help
            Maximum time to wait for WiFi connection in milliseconds.

    config ENABLE_WIFI_AUTO_CONNECT
        bool "Enable automatic WiFi connection on startup"
        default y
        help
            Automatically connect to WiFi network on system startup.

    config WIFI_SCAN_RSSI_THRESHOLD
        int "WiFi Scan RSSI threshold"
        default -127
        help
            Weakest allowable signal strength for WiFi connection.

    config WIFI_CONNECT_AP_BY_SIGNAL
        bool "Connect to AP with best signal"
        default n
        help
            When multiple APs with same SSID are available, connect to the one with strongest signal.

    menu "Advanced WiFi Settings"
        config WIFI_LISTEN_INTERVAL
            int "WiFi Listen Interval"
            default 3
            help
                Interval for station to listen to beacon from AP. The unit of listen interval is one beacon interval.

        config WIFI_BEACON_TIMEOUT
            int "WiFi Beacon Timeout"
            default 6
            help
                For station to timeout after losing beacon from AP.

        config WIFI_MAX_TX_POWER
            int "WiFi Maximum TX Power (0.25dBm units)"
            range 8 84
            default 84
            help
                Maximum WiFi TX power in 0.25dBm units. Default is 21dBm (84*0.25).

        config ENABLE_WIFI_NVS_FLASH
            bool "Enable WiFi settings storage in NVS flash"
            default y
            help
                Store WiFi settings in non-volatile storage for persistence across reboots.
    endmenu
endmenu
```
