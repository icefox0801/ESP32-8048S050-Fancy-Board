## sdkconfig.defaults.esp32s3
```kconfig
# ==========================================================
# ESP32-S3-8048S050 Development Board Configuration
# 5.0" 800x480 RGB LCD Display with 16MB Flash & 8MB PSRAM
# ==========================================================

# ----------------------------------------------------------
# Memory and Task Configuration (Conservative for Stability)
# ----------------------------------------------------------
CONFIG_ESP_MAIN_TASK_STACK_SIZE=16384
CONFIG_FREERTOS_IDLE_TASK_STACKSIZE=8192
CONFIG_ESP_INT_WDT_TIMEOUT_MS=1500
CONFIG_ESP_TASK_WDT_TIMEOUT_S=30

# Heap debugging and corruption detection
CONFIG_HEAP_POISONING_LIGHT=y
CONFIG_HEAP_TRACING=y
CONFIG_HEAP_TASK_TRACKING=y

# ESP Timer task stack size (conservative)
CONFIG_ESP_TIMER_TASK_STACK_SIZE=6144
CONFIG_ESP_TIMER_INTERRUPT_LEVEL=1

# System event task stack size (conservative)
CONFIG_ESP_SYSTEM_EVENT_TASK_STACK_SIZE=12288

# Additional task stack sizes for stability (conservative)
CONFIG_FREERTOS_TIMER_TASK_STACK_DEPTH=6144

# Stack overflow detection and monitoring
CONFIG_FREERTOS_CHECK_STACKOVERFLOW_CANARY=y
CONFIG_FREERTOS_WATCHPOINT_END_OF_STACK=y
CONFIG_ESP_SYSTEM_CHECK_INT_LEVEL_5=y

# TCP/IP task stack size (conservative)
CONFIG_LWIP_TCPIP_TASK_STACK_SIZE=8192

# ----------------------------------------------------------
# PSRAM Configuration (8MB Octal SPI PSRAM) - Conservative
# ----------------------------------------------------------
CONFIG_SPIRAM=y
CONFIG_SPIRAM_MODE_OCT=y
CONFIG_SPIRAM_SPEED_80M=y
CONFIG_SPIRAM_XIP_FROM_PSRAM=y
CONFIG_SPIRAM_USE_MALLOC=y
CONFIG_SPIRAM_MALLOC_ALWAYSINTERNAL=4096
CONFIG_SPIRAM_TRY_ALLOCATE_WIFI_LWIP=y

# SPIRAM Configuration for 8MB PSRAM - Aggressive WiFi optimization
# Reserve more internal RAM but force all network buffers to SPIRAM
CONFIG_SPIRAM_MALLOC_RESERVE_INTERNAL=65536

# Additional SPIRAM heap optimizations for 8MB PSRAM
# Increase heap task stack for better SPIRAM management
CONFIG_ESP_MAIN_TASK_STACK_SIZE=16384
# Enable SPIRAM for heap trace (debugging large allocations)
CONFIG_HEAP_TRACING=y

# ----------------------------------------------------------
# WiFi Memory Optimization - Force all WiFi buffers to SPIRAM
# ----------------------------------------------------------
# WiFi buffer settings - INCREASED for large HTTP response optimization (100KB+)
CONFIG_ESP_WIFI_STATIC_RX_BUFFER_NUM=8
CONFIG_ESP_WIFI_STATIC_TX_BUFFER_NUM=4
CONFIG_ESP_WIFI_CACHE_TX_BUFFER_NUM=8
CONFIG_ESP_WIFI_MGMT_SBUF_NUM=12
CONFIG_ESP_WIFI_DYNAMIC_RX_BUFFER_NUM=20
CONFIG_ESP_WIFI_DYNAMIC_TX_BUFFER_NUM=8
CONFIG_ESP_WIFI_AMPDU_RX_ENABLED=y
CONFIG_ESP_WIFI_AMPDU_TX_ENABLED=y
CONFIG_ESP_WIFI_AMSDU_TX_ENABLED=y
CONFIG_ESP_WIFI_RX_BA_WIN=6
CONFIG_ESP_WIFI_TX_BA_WIN=16

# Force ALL WiFi RX buffers to use SPIRAM (critical for DRAM reduction)
# Note: ESP-IDF automatically allocates WiFi buffers in SPIRAM when CONFIG_SPIRAM_TRY_ALLOCATE_WIFI_LWIP=y

# LWIP Memory Configuration - Force TCP/IP stack to use SPIRAM
CONFIG_LWIP_TCPIP_RECVMBOX_SIZE=32
CONFIG_LWIP_UDP_RECVMBOX_SIZE=6
CONFIG_LWIP_TCP_RECVMBOX_SIZE=6
CONFIG_LWIP_TCP_SND_BUF_DEFAULT=5760
CONFIG_LWIP_TCP_WND_DEFAULT=5760
CONFIG_LWIP_TCP_MSS=1436

# Force LWIP to use SPIRAM for all memory pools and buffers
CONFIG_LWIP_TCPIP_TASK_STACK_SIZE=4096
CONFIG_LWIP_PPP_SUPPORT=n
CONFIG_LWIP_SLIP_SUPPORT=n

# Additional LWIP SPIRAM optimizations
CONFIG_LWIP_TCPIP_CORE_LOCKING=y
CONFIG_LWIP_TCPIP_CORE_LOCKING_INPUT=y
CONFIG_LWIP_SO_REUSE=y
CONFIG_LWIP_SO_REUSE_RXTOALL=y
CONFIG_LWIP_IP_FORWARD=n
CONFIG_LWIP_STATS=n

# Force WiFi task stack to use SPIRAM - INCREASED for 100KB+ HTTP performance
CONFIG_ESP_WIFI_TASK_STACK_SIZE=6144

# TCP optimizations for large HTTP responses (100KB+) - AGGRESSIVE SPIRAM usage
CONFIG_LWIP_TCP_MSS=1460
CONFIG_LWIP_TCP_WND=32768
CONFIG_LWIP_TCP_RECVMBOX_SIZE=16
CONFIG_LWIP_TCP_SND_BUF_DEFAULT=32768
CONFIG_LWIP_TCPIP_RECVMBOX_SIZE=64

# Additional WiFi SPIRAM optimizations
CONFIG_ESP_WIFI_IRAM_OPT=y
CONFIG_ESP_WIFI_RX_IRAM_OPT=y

# Additional WiFi optimizations to reduce DRAM usage
CONFIG_ESP_WIFI_SLP_IRAM_OPT=y
CONFIG_ESP_WIFI_FTM_ENABLE=n
CONFIG_ESP_WIFI_GCMP_SUPPORT=n
CONFIG_ESP_WIFI_GMAC_SUPPORT=n
CONFIG_ESP_WIFI_SOFTAP_SUPPORT=n
CONFIG_ESP_WIFI_ESP_NOW_SUPPORT=n
CONFIG_ESP_WIFI_MESH_SUPPORT=n

# Force WiFi NVS storage to use SPIRAM when possible
CONFIG_ESP_WIFI_NVS_ENABLED=y

# ----------------------------------------------------------
# Flash Memory Configuration (16MB)
# ----------------------------------------------------------
CONFIG_ESPTOOLPY_FLASHMODE_DIO=y
CONFIG_ESPTOOLPY_FLASHMODE="dio"
CONFIG_ESPTOOLPY_FLASHFREQ_80M=y
CONFIG_ESPTOOLPY_FLASHFREQ="80m"
CONFIG_ESPTOOLPY_FLASHSIZE_16MB=y
CONFIG_ESPTOOLPY_FLASHSIZE="16MB"

# ----------------------------------------------------------
# Partition Table Configuration
# ----------------------------------------------------------
CONFIG_PARTITION_TABLE_CUSTOM=y
CONFIG_PARTITION_TABLE_CUSTOM_FILENAME="partitions.csv"
CONFIG_PARTITION_TABLE_FILENAME="partitions.csv"
CONFIG_PARTITION_TABLE_OFFSET=0x8000
CONFIG_PARTITION_TABLE_MD5=y

# ----------------------------------------------------------
# LVGL Graphics Library Configuration
# ----------------------------------------------------------
CONFIG_LV_COLOR_DEPTH_16=y
# Reduced refresh rate to 10Hz (100ms) - optimized for power and memory efficiency
CONFIG_LV_DEF_REFR_PERIOD=100
CONFIG_LV_OS_FREERTOS=y
# LVGL Memory Configuration - Reduced for DRAM optimization
# Use minimal memory allocation for LVGL since it's in DRAM, not SPIRAM
CONFIG_LV_MEM_SIZE_KILOBYTES=64

# Optimize LVGL draw buffer to reasonable size
CONFIG_LV_DRAW_LAYER_SIMPLE_BUF_SIZE=16384

# LVGL Performance Optimizations for 10Hz refresh and massive SPIRAM
# Enable caching and pre-rendering for maximum efficiency
CONFIG_LV_USE_PERF_MONITOR=y
CONFIG_LV_USE_MEM_MONITOR=y

# LVGL Montserrat Font Configuration (optimized selection)
CONFIG_LV_FONT_MONTSERRAT_12=y
CONFIG_LV_FONT_MONTSERRAT_14=y
CONFIG_LV_FONT_MONTSERRAT_16=y
CONFIG_LV_FONT_MONTSERRAT_18=y
CONFIG_LV_FONT_MONTSERRAT_20=y
CONFIG_LV_FONT_MONTSERRAT_22=y
CONFIG_LV_FONT_MONTSERRAT_24=y
CONFIG_LV_FONT_MONTSERRAT_28=y
CONFIG_LV_FONT_MONTSERRAT_32=y
CONFIG_LV_FONT_MONTSERRAT_36=y
CONFIG_LV_FONT_MONTSERRAT_40=y
CONFIG_LV_FONT_MONTSERRAT_48=y

# Enable LVGL built-in fonts
CONFIG_LV_FONT_DEFAULT_MONTSERRAT_14=y

# ----------------------------------------------------------
# LCD CAM and RGB Panel Configuration
# ----------------------------------------------------------
CONFIG_LCD_RGB_ISR_IRAM_SAFE=y
CONFIG_LCD_RGB_RESTART_IN_VSYNC=y

# ----------------------------------------------------------
# RGB LCD Hardware Configuration (ST7262 Controller)
# ----------------------------------------------------------
CONFIG_EXAMPLE_LCD_DATA_LINES_16=y

# LCD Control Signals
CONFIG_EXAMPLE_LCD_VSYNC_GPIO=41
CONFIG_EXAMPLE_LCD_HSYNC_GPIO=39
CONFIG_EXAMPLE_LCD_DE_GPIO=40
CONFIG_EXAMPLE_LCD_PCLK_GPIO=42

# RGB Data Lines (16-bit parallel interface)
# Blue Channel (B3-B7 -> DATA0-DATA4)
CONFIG_EXAMPLE_LCD_DATA0_GPIO=8
CONFIG_EXAMPLE_LCD_DATA1_GPIO=3
CONFIG_EXAMPLE_LCD_DATA2_GPIO=46
CONFIG_EXAMPLE_LCD_DATA3_GPIO=9
CONFIG_EXAMPLE_LCD_DATA4_GPIO=1

# Green Channel (G2-G7 -> DATA5-DATA10)
CONFIG_EXAMPLE_LCD_DATA5_GPIO=5
CONFIG_EXAMPLE_LCD_DATA6_GPIO=6
CONFIG_EXAMPLE_LCD_DATA7_GPIO=7
CONFIG_EXAMPLE_LCD_DATA8_GPIO=15
CONFIG_EXAMPLE_LCD_DATA9_GPIO=16
CONFIG_EXAMPLE_LCD_DATA10_GPIO=4

# Red Channel (R3-R7 -> DATA11-DATA15)
CONFIG_EXAMPLE_LCD_DATA11_GPIO=45
CONFIG_EXAMPLE_LCD_DATA12_GPIO=48
CONFIG_EXAMPLE_LCD_DATA13_GPIO=47
CONFIG_EXAMPLE_LCD_DATA14_GPIO=21
CONFIG_EXAMPLE_LCD_DATA15_GPIO=14

# ----------------------------------------------------------
# FreeRTOS Configuration
# ----------------------------------------------------------
CONFIG_FREERTOS_TIMER_TASK_STACK_DEPTH=4096

# ----------------------------------------------------------
# WiFi Performance Optimization for Large HTTP Transfers (100KB+)
# ----------------------------------------------------------
# Enable WiFi performance modes for large data transfers
CONFIG_ESP_WIFI_11B_RATE_ENABLED=n
CONFIG_ESP_WIFI_11G_RATE_ENABLED=y
CONFIG_ESP_WIFI_11N_RATE_ENABLED=y
CONFIG_ESP_WIFI_AMPDU_RX_ENABLED=y
CONFIG_ESP_WIFI_AMPDU_TX_ENABLED=y
CONFIG_ESP_WIFI_AMSDU_TX_ENABLED=y
# Increase WiFi Tx power for better performance
CONFIG_ESP_PHY_MAX_WIFI_TX_POWER=20

# ----------------------------------------------------------
# HTTP Client Optimization for Large Responses (100KB+)
# ----------------------------------------------------------
CONFIG_ESP_HTTP_CLIENT_ENABLE_HTTPS=y
CONFIG_ESP_HTTP_CLIENT_BUFFER_SIZE=8192

# ----------------------------------------------------------
# Serial Monitor Configuration & Debugging
# ----------------------------------------------------------
CONFIG_ESPTOOLPY_MONITOR_BAUD=115200

# Enable debug logging for LCD and LVGL
CONFIG_LOG_DEFAULT_LEVEL_DEBUG=y
CONFIG_LOG_MAXIMUM_LEVEL=4

# ----------------------------------------------------------
# Flash Programming Behavior
# ----------------------------------------------------------
CONFIG_ESPTOOLPY_BEFORE_RESET=y
CONFIG_ESPTOOLPY_BEFORE="default_reset"
CONFIG_ESPTOOLPY_AFTER_RESET=y
CONFIG_ESPTOOLPY_AFTER="hard_reset"
```
